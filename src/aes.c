// Minimal AES-128 CTR with MixColumns using a small PROGMEM xtime table.
// Optimized for AVR (ATtiny1606) to keep code and data small.

#include <stdint.h>
#include <string.h>
#include <avr/pgmspace.h>
#include "aes.h"

#define Nk 4
#define Nr 10
#define Nb 4

// S-box in PROGMEM (keeps it in flash)
static const uint8_t sbox[256] PROGMEM = {
  0x63,0x7c,0x77,0x7b,0xf2,0x6b,0x6f,0xc5,0x30,0x01,0x67,0x2b,0xfe,0xd7,0xab,0x76,
  0xca,0x82,0xc9,0x7d,0xfa,0x59,0x47,0xf0,0xad,0xd4,0xa2,0xaf,0x9c,0xa4,0x72,0xc0,
  0xb7,0xfd,0x93,0x26,0x36,0x3f,0xf7,0xcc,0x34,0xa5,0xe5,0xf1,0x71,0xd8,0x31,0x15,
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  0x8c,0xa1,0x89,0x0d,0xbf,0xe6,0x42,0x68,0x41,0x99,0x2d,0x0f,0xb0,0x54,0xbb,0x16
};

// rcon in RAM (tiny)
static const uint8_t rcon[11] = {0x8d,0x01,0x02,0x04,0x08,0x10,0x20,0x40,0x80,0x1b,0x36};

// xtime table (2*x in GF(2^8)) stored in PROGMEM (256 bytes)
// Using this + a small XOR gives multiply-by-3 cheaply.
static const uint8_t xtime_tbl[256] PROGMEM = {
  0x00,0x02,0x04,0x06,0x08,0x0A,0x0C,0x0E,0x10,0x12,0x14,0x16,0x18,0x1A,0x1C,0x1E,
  0x20,0x22,0x24,0x26,0x28,0x2A,0x2C,0x2E,0x30,0x32,0x34,0x36,0x38,0x3A,0x3C,0x3E,
  0x40,0x42,0x44,0x46,0x48,0x4A,0x4C,0x4E,0x50,0x52,0x54,0x56,0x58,0x5A,0x5C,0x5E,
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  0xFB,0xF9,0xFF,0xFD,0xF3,0xF1,0xF7,0xF5,0xEB,0xE9,0xEF,0xED,0xE3,0xE1,0xE7,0xE5
};

// Key expansion
static void KeyExpansion(uint8_t* RoundKey, const uint8_t* Key) {
  uint8_t tempa[4];
  uint32_t i, j, k;
  for (i = 0; i < Nk; ++i) {
    RoundKey[i*4+0] = Key[i*4+0];
    RoundKey[i*4+1] = Key[i*4+1];
    RoundKey[i*4+2] = Key[i*4+2];
    RoundKey[i*4+3] = Key[i*4+3];
  }
  for (i = Nk; i < Nb*(Nr+1); ++i) {
    k = (i-1)*4;
    tempa[0] = RoundKey[k+0];
    tempa[1] = RoundKey[k+1];
    tempa[2] = RoundKey[k+2];
    tempa[3] = RoundKey[k+3];
    if (i % Nk == 0) {
      uint8_t t = tempa[0];
      tempa[0] = tempa[1]; tempa[1] = tempa[2];
      tempa[2] = tempa[3]; tempa[3] = t;
      tempa[0] = pgm_read_byte(&sbox[tempa[0]]);
      tempa[1] = pgm_read_byte(&sbox[tempa[1]]);
      tempa[2] = pgm_read_byte(&sbox[tempa[2]]);
      tempa[3] = pgm_read_byte(&sbox[tempa[3]]);
      tempa[0] ^= rcon[i/Nk];
    }
    j = i*4; k = (i-Nk)*4;
    RoundKey[j+0] = RoundKey[k+0] ^ tempa[0];
    RoundKey[j+1] = RoundKey[k+1] ^ tempa[1];
    RoundKey[j+2] = RoundKey[k+2] ^ tempa[2];
    RoundKey[j+3] = RoundKey[k+3] ^ tempa[3];
  }
}

static void AddRoundKey(uint8_t round, uint8_t* state, const uint8_t* RoundKey) {
  for (uint8_t i = 0; i < 16; ++i)
    state[i] ^= RoundKey[(round * Nb * 4) + i];
}

static void SubBytes(uint8_t* state) {
  for (uint8_t i = 0; i < 16; ++i)
    state[i] = pgm_read_byte(&sbox[state[i]]);
}

static void ShiftRows(uint8_t* s) {
  uint8_t t;
  t = s[1]; s[1] = s[5]; s[5] = s[9]; s[9] = s[13]; s[13] = t;
  t = s[2]; s[2] = s[10]; s[10] = t;
  t = s[6]; s[6] = s[14]; s[14] = t;
  t = s[3]; s[3] = s[15]; s[15] = s[11]; s[11] = s[7]; s[7] = t;
}

// MixColumns using xtime_tbl lookup (2*x) and a small XOR for multiply-by-3
static void MixColumns(uint8_t* state) {
  for (uint8_t i = 0; i < 4; ++i) {
    uint8_t *s = state + i*4;
    uint8_t a0 = s[0], a1 = s[1], a2 = s[2], a3 = s[3];

    uint8_t a0x = pgm_read_byte(&xtime_tbl[a0]); // 2*a0
    uint8_t a1x = pgm_read_byte(&xtime_tbl[a1]); // 2*a1
    uint8_t a2x = pgm_read_byte(&xtime_tbl[a2]); // 2*a2
    uint8_t a3x = pgm_read_byte(&xtime_tbl[a3]); // 2*a3

    // multiply by 3 = xtime(x) ^ x
    uint8_t a0m3 = a0x ^ a0;
    uint8_t a1m3 = a1x ^ a1;
    uint8_t a2m3 = a2x ^ a2;
    uint8_t a3m3 = a3x ^ a3;

    s[0] = a0x ^ a1m3 ^ a2 ^ a3;
    s[1] = a0 ^ a1x ^ a2m3 ^ a3;
    s[2] = a0 ^ a1 ^ a2x ^ a3m3;
    s[3] = a0m3 ^ a1 ^ a2 ^ a3x;
  }
}

// Public API
void AES_init_ctx_iv(AES_ctx* ctx, const uint8_t* key, const uint8_t* iv) {
  KeyExpansion(ctx->RoundKey, key);
  memcpy(ctx->Iv, iv, 16);
}

void AES_CTR_xcrypt_buffer(AES_ctx* ctx, uint8_t* buf, uint32_t length) {
  uint8_t buffer[16], state[16];
  uint32_t i; int bi;
  for (i = 0, bi = 16; i < length; ++i, ++bi) {
    if (bi == 16) {
      memcpy(buffer, ctx->Iv, 16);
      memcpy(state, buffer, 16);

      AddRoundKey(0, state, ctx->RoundKey);
      for (uint8_t round = 1; round < Nr; ++round) {
        SubBytes(state);
        ShiftRows(state);
        MixColumns(state);
        AddRoundKey(round, state, ctx->RoundKey);
      }
      SubBytes(state);
      ShiftRows(state);
      AddRoundKey(Nr, state, ctx->RoundKey);

      memcpy(buffer, state, 16);

      // increment IV (big-endian style)
      for (bi = 15; bi >= 0; --bi) {
        if (ctx->Iv[bi] == 255) {
          ctx->Iv[bi] = 0;
          continue;
        }
        ctx->Iv[bi] += 1;
        break;
      }
      bi = 0;
    }
    buf[i] ^= buffer[bi];
  }
}
